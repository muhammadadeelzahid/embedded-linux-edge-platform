## conf/distro/edge-platform.conf
```bitbake
# Inherit settings from the default Yocto reference distro
require conf/distro/poky.conf

# Distro Identity
DISTRO = "edge-platform"
DISTRO_NAME = "Raspberry Pi Edge Platform"
DISTRO_VERSION = "1.1.0"
DISTRO_CODENAME = "scarthgap"

DISTRO_FEATURES:append = " systemd usrmerge"
VIRTUAL-RUNTIME_init_manager = "systemd"
DISTRO_FEATURES_BACKFILL_CONSIDERED += "sysvinit"
VIRTUAL-RUNTIME_initscripts = "systemd-compat-units"
```
